/*********************************************************************************************************
* 模块名称: Main.c
* 摘    要: 主文件，包含软硬件初始化以及main函数
* 当前版本: 1.0.0
* 作    者: SZLY(COPYRIGHT 2018 SZLY. All rights reserved.)
* 完成日期: 2018年01月01日
* 内    容:
* 注    意: 注意勾选Options for Target 'Target1'->Code Generation->Use MicroLIB                                                                  
**********************************************************************************************************
* 取代版本: 
* 作    者:
* 完成日期: 
* 修改内容:
* 修改文件: 
*********************************************************************************************************/

/*********************************************************************************************************
*                                              包含头文件
*********************************************************************************************************/
#include <stm32f10x_conf.h>
#include "Main.h"
#include "DataType.h"
#include "Timer.h"
#include "UART1.h"
#include "NVIC.h"
#include "RCC.h"
#include "LED.h"
#include "SysTick.h"
#include "OLED.h"

/*********************************************************************************************************
*                                              宏定义
*********************************************************************************************************/

/*********************************************************************************************************
*                                              内部变量
*********************************************************************************************************/
u32 total;

typedef struct
{
  char ch;
  u32 pos;
}Name;

/*********************************************************************************************************
*                                              枚举结构体定义
*********************************************************************************************************/

/*********************************************************************************************************
*                                              内部函数声明
*********************************************************************************************************/
static  void  InitSoftware(void);   //初始化软件相关的模块
static  void  InitHardware(void);   //初始化硬件相关的模块
static  void  Proc2msTask(void);    //处理2ms任务
static  void  Proc1SecTask(Name MyName[]);   //处理1s任务

/*********************************************************************************************************
*                                              内部函数实现
*********************************************************************************************************/

/*********************************************************************************************************
* 函数名称: InitSoftware
* 函数功能: 所有的软件相关的模块初始化函数都放在此函数中
* 输入参数: void
* 输出参数: void
* 返 回 值: void
* 创建日期: 2018年01月01日
* 注    意: 
*********************************************************************************************************/
static  void  InitSoftware(void)
{
  
}

/*********************************************************************************************************
* 函数名称: InitHardware
* 函数功能: 所有的硬件相关的模块初始化函数都放在此函数中
* 输入参数: void
* 输出参数: void
* 返 回 值: void
* 创建日期: 2018年01月01日
* 注    意: 
*********************************************************************************************************/
static  void  InitHardware(void)
{  
  SystemInit();       //系统初始化
  InitRCC();          //初始化RCC模块
  InitNVIC();         //初始化NVIC模块
  InitUART1(115200);  //初始化UART模块
  InitTimer();        //初始化Timer模块
  InitLED();          //初始化LED模块
  InitSysTick();      //初始化SysTick模块
  InitOLED();
}
void ShowTime(){
  u32 sec = total % 60;
  u32 min = (total / 60) % 60;
  u32 hour = total / 3600; 

  OLEDShowNum(32, 32, hour / 10, 1, 16);
  OLEDShowNum(40, 32, hour % 10, 1, 16);
  OLEDShowNum(56, 32, min / 10, 1, 16);
  OLEDShowNum(64, 32, min % 10, 1, 16);
  OLEDShowNum(80, 32, sec / 10, 1, 16);
  OLEDShowNum(88, 32, sec % 10, 1, 16);
}

void InitName(Name MyName[]){
  MyName[0].ch = 'J';
  MyName[1].ch = 'Y';
  MyName[2].ch = '-';
  MyName[3].ch = 'H';
  MyName[4].ch = 'U';
  MyName[5].ch = 'A';
  MyName[6].ch = 'N';
  MyName[7].ch = 'G';
  
  MyName[0].pos = 32;
  MyName[1].pos = 40;
  MyName[2].pos = 48;
  MyName[3].pos = 56;
  MyName[4].pos = 64;
  MyName[5].pos = 72;
  MyName[6].pos = 80;
  MyName[7].pos = 88;
}

void MovName(Name MyName[]){
  u32 i = 0;
  for(i = 0; i < 8; i++){
    (MyName[i].pos == 0) ? (MyName[i].pos = 120) : (MyName[i].pos -= 8);
  }
}

void ShowName(Name MyName[]){
  u32 i;
  for(i = 0; i < 8; i++){
    OLEDShowChar(MyName[i].pos, 48, MyName[i].ch, 16, i % 2);
  }
}

void ShowDate(){
  OLEDShowString(24, 16, "2018-01-01");
}

/*********************************************************************************************************
* 函数名称: Proc2msTask
* 函数功能: 处理2ms任务 
* 输入参数: void
* 输出参数: void
* 返 回 值: void
* 创建日期: 2018年01月01日
* 注    意: 
*********************************************************************************************************/
static  void  Proc2msTask(void)
{  
  if(Get2msFlag())  //检查2ms标志状态
  {  
    LEDFlicker(250);  
           
    Clr2msFlag();   //清除2ms标志
  }    
}

/*********************************************************************************************************
* 函数名称: Proc1SecTask
* 函数功能: 处理1sec任务 
* 输入参数: void
* 输出参数: void
* 返 回 值: void
* 创建日期: 2018年01月01日
* 注    意: 
*********************************************************************************************************/
static  void  Proc1SecTask(Name MyName[])
{
  if(Get1SecFlag())    //检查1s标志状态
  {
    OLEDClear();


    OLEDShowString(8, 0, "STM32F1Board");
    OLEDShowString(48, 32, "-  -");
    ShowDate();
    
    total++;
    ShowName(MyName);
    ShowTime();
    OLEDRefreshGRAM();
    MovName(MyName);
    
    Clr1SecFlag();     //清除1s标志
  }    
}

/*********************************************************************************************************
* 函数名称: main
* 函数功能: 主函数 
* 输入参数: void
* 输出参数: void
* 返 回 值: int
* 创建日期: 2018年01月01日
* 注    意: 
*********************************************************************************************************/
int main(void)
{
  Name MyName[8];
  InitSoftware();   //初始化软件相关函数
  InitHardware();   //初始化硬件相关函数
  
  printf("Init System has been finished.\r\n" );  //打印系统状态


  total = 3590;

  InitName(MyName);
  
  while(1)
  {
    Proc2msTask();  //处理2ms任务
    Proc1SecTask(MyName); //处理1sec任务   
  }
}

