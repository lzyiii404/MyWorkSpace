/*********************************************************************************************************
* 模块名称: ProcKeyOne.c
* 摘    要: 独立按键处理模块，进行独立按键处理模块初始化，以及独立按键处理函数实现
* 当前版本: 1.0.0
* 作    者: SZLY(COPYRIGHT 2018 SZLY. All rights reserved.)
* 完成日期: 2018年01月01日  
* 内    容:
* 注    意: none                                                                  
**********************************************************************************************************
* 取代版本: 
* 作    者:
* 完成日期: 
* 修改内容:
* 修改文件: 
*********************************************************************************************************/

/*********************************************************************************************************
*                                              包含头文件
*********************************************************************************************************/
#include <stm32f10x_conf.h>
#include "ProcKeyOne.h"
#include "UART1.h"
#include "LED.h"

/*********************************************************************************************************
*                                              宏定义
*********************************************************************************************************/
#define   LED_1(a)     if(a)\
                        GPIO_SetBits(GPIOC, GPIO_Pin_4);\
                      else\
                        GPIO_ResetBits(GPIOC, GPIO_Pin_4);

#define   LED_2(a)     if(a)\
                        GPIO_SetBits(GPIOC, GPIO_Pin_5);\
                      else\
                        GPIO_ResetBits(GPIOC, GPIO_Pin_5);  
/*********************************************************************************************************
*                                              枚举结构体定义
*********************************************************************************************************/

/*********************************************************************************************************
*                                              内部变量
*********************************************************************************************************/
u32 array[] = {00, 01, 10, 11};
int tmp = 0;
/*********************************************************************************************************
*                                              内部函数声明
*********************************************************************************************************/
void delay(){
  u32 i = 0x5fffff;
  for(; i != 0; i--);
}
/*********************************************************************************************************
*                                              内部函数实现
*********************************************************************************************************/

/*********************************************************************************************************
*                                              API函数实现
*********************************************************************************************************/
/*********************************************************************************************************
* 函数名称: InitProcKeyOne
* 函数功能: 初始化ProcKeyOne
* 输入参数: void
* 输出参数: void
* 返 回 值: void
* 创建日期: 2018年01月01日
* 注    意:
*********************************************************************************************************/
void InitProcKeyOne(void)
{
  
}

/*********************************************************************************************************
* 函数名称: ProcKeyDownKey1
* 函数功能: 处理按键按下的事件，即按键按下的响应函数 
* 输入参数: void
* 输出参数: void
* 返 回 值: void
* 创建日期: 2018年01月01日
* 注    意: 
*********************************************************************************************************/
void  ProcKeyDownKey1(void)
{  
  printf("KEY1 PUSH DOWN\r\n");  //打印按键状态

	GPIO_SetBits(GPIOC, GPIO_Pin_0);
  //LED_2(0);
}

/*********************************************************************************************************
* 函数名称: ProcKeyUpKey1
* 函数功能: 处理按键弹起的事件，即按键弹起的响应函数 
* 输入参数: void
* 输出参数: void
* 返 回 值: void
* 创建日期: 2018年01月01日
* 注    意: 
*********************************************************************************************************/
void  ProcKeyUpKey1(void)
{
	GPIO_ResetBits(GPIOC, GPIO_Pin_0);
  //printf("KEY1 RELEASE\r\n");   //打印按键状态
}

/*********************************************************************************************************
* 函数名称: ProcKeyDownKey2
* 函数功能: 处理按键按下的事件，即按键按下的响应函数 
* 输入参数: void
* 输出参数: void
* 返 回 值: void
* 创建日期: 2018年01月01日
* 注    意: 
*********************************************************************************************************/
void  ProcKeyDownKey2(void)
{
  printf("KEY2 PUSH DOWN\r\n");   //打印按键状态
  for(tmp = 0; tmp != 5; tmp++){
    LED_1(array[tmp % 4] / 10);
    LED_2(array[tmp % 4] % 10);
    delay();
  }
  tmp = 0;
}

/*********************************************************************************************************
* 函数名称: ProcKeyUpKey2
* 函数功能: 处理按键弹起的事件，即按键弹起的响应函数 
* 输入参数: void
* 输出参数: void
* 返 回 值: void
* 创建日期: 2018年01月01日
* 注    意: 
*********************************************************************************************************/
void  ProcKeyUpKey2(void)
{
  printf("KEY2 RELEASE\r\n");     //打印按键状态
}

/*********************************************************************************************************
* 函数名称: ProcKeyDownKey3
* 函数功能: 处理按键按下的事件，即按键按下的响应函数 
* 输入参数: void
* 输出参数: void
* 返 回 值: void
* 创建日期: 2018年01月01日
* 注    意: 
*********************************************************************************************************/
void  ProcKeyDownKey3(void)
{
  printf("KEY3 PUSH DOWN\r\n");   //打印按键状态
  for (tmp = 4; tmp >= 0; tmp--){
    LED_1(array[tmp % 4] / 10);
    LED_2(array[tmp % 4] % 10);
    delay();
  }
  tmp = 0;
}

/*********************************************************************************************************
* 函数名称: ProcKeyUpKey3
* 函数功能: 处理按键弹起的事件，即按键弹起的响应函数 
* 输入参数: void
* 输出参数: void
* 返 回 值: void
* 创建日期: 2018年01月01日
* 注    意: 
*********************************************************************************************************/
void  ProcKeyUpKey3(void)
{  
  printf("KEY3 RELEASE\r\n");     //打印按键状态
}
